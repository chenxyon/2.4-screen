#include <stdio.h>
#include "w25q128.h"
#include "freertos/FreeRTOS.h"
#include "freertos/task.h"
#include "driver/gpio.h"
#include "driver/spi_master.h"
#include "driver/i2c.h"
#include "esp_err.h"
#include "esp_log.h"
#include "esp_partition.h"
#include "esp_ota_ops.h"
#define VERSION_MAJOR 1
#define VERSION_MINOR 0
#define VERSION_PATCH 0
#include "font_chinese_longyin.h"

#define FIRMWARE_BACKUP_ADDR 0x000000
#define FIRMWARE_SIZE 0xE0000



static const char *TAG = "TFT_TEST";

#define LCD_HOST SPI2_HOST

#define EXAMPLE_PIN_NUM_SCLK GPIO_NUM_10
#define EXAMPLE_PIN_NUM_MOSI GPIO_NUM_13
#define EXAMPLE_PIN_NUM_MISO -1
#define EXAMPLE_PIN_NUM_LCD_DC GPIO_NUM_11
#define EXAMPLE_PIN_NUM_LCD_RST GPIO_NUM_14
#define EXAMPLE_PIN_NUM_LCD_CS GPIO_NUM_12

#define I2C_NUM I2C_NUM_0
#define IIC0_SDA_GPIO_PIN GPIO_NUM_41
#define IIC0_SCL_GPIO_PIN GPIO_NUM_42
#define IIC_FREQ 400000

#define XL9555_ADDR 0x20
#define XL9555_OUTPUT_PORT0_REG 2
#define XL9555_OUTPUT_PORT1_REG 3
#define XL9555_CONFIG_PORT0_REG 6
#define XL9555_CONFIG_PORT1_REG 7

#define LCD_BL_IO 0x0100
#define SLCD_RST_IO 0x0400
#define SLCD_PWR_IO 0x0800

#define LCD_WIDTH  320
#define LCD_HEIGHT 240

#define WHITE   0xFFFF
#define BLACK   0x0000
#define RED     0xF800
#define GREEN   0x07E0
#define BLUE    0x001F
#define YELLOW  0xFFE0

spi_device_handle_t lcd_spi_handle = NULL;

static void i2c_init(void)
{
    i2c_config_t conf = {
        .mode = I2C_MODE_MASTER,
        .sda_io_num = IIC0_SDA_GPIO_PIN,
        .scl_io_num = IIC0_SCL_GPIO_PIN,
        .sda_pullup_en = GPIO_PULLUP_ENABLE,
        .scl_pullup_en = GPIO_PULLUP_ENABLE,
        .master.clk_speed = IIC_FREQ,
    };
    i2c_param_config(I2C_NUM, &conf);
    i2c_driver_install(I2C_NUM, I2C_MODE_MASTER, 0, 0, 0);
}

static void xl9555_write_byte(uint8_t reg, uint8_t *data, size_t len)
{
    i2c_cmd_handle_t cmd = i2c_cmd_link_create();
    i2c_master_start(cmd);
    i2c_master_write_byte(cmd, XL9555_ADDR << 1, true);
    i2c_master_write_byte(cmd, reg, true);
    for (size_t i = 0; i < len; i++) {
        i2c_master_write_byte(cmd, data[i], true);
    }
    i2c_master_stop(cmd);
    i2c_master_cmd_begin(I2C_NUM, cmd, 100 / portTICK_PERIOD_MS);
    i2c_cmd_link_delete(cmd);
}

static void xl9555_pin_write(uint16_t pin, int val)
{
    uint8_t w_data[2] = {0};
    
    i2c_cmd_handle_t cmd = i2c_cmd_link_create();
    i2c_master_start(cmd);
    i2c_master_write_byte(cmd, XL9555_ADDR << 1, true);
    i2c_master_write_byte(cmd, XL9555_OUTPUT_PORT0_REG, true);
    i2c_master_stop(cmd);
    i2c_master_cmd_begin(I2C_NUM, cmd, 100 / portTICK_PERIOD_MS);
    i2c_cmd_link_delete(cmd);

    cmd = i2c_cmd_link_create();
    i2c_master_start(cmd);
    i2c_master_write_byte(cmd, (XL9555_ADDR << 1) | 1, true);
    i2c_master_read(cmd, w_data, 2, I2C_MASTER_LAST_NACK);
    i2c_master_stop(cmd);
    i2c_master_cmd_begin(I2C_NUM, cmd, 100 / portTICK_PERIOD_MS);
    i2c_cmd_link_delete(cmd);

    if (pin <= 0x00FF) {
        if (val) {
            w_data[0] |= (uint8_t)(0xFF & pin);
        } else {
            w_data[0] &= ~(uint8_t)(0xFF & pin);
        }
    } else {
        if (val) {
            w_data[1] |= (uint8_t)(0xFF & (pin >> 8));
        } else {
            w_data[1] &= ~(uint8_t)(0xFF & (pin >> 8));
        }
    }

    xl9555_write_byte(XL9555_OUTPUT_PORT0_REG, w_data, 2);
}

static void lcd_hard_reset(void)
{
    gpio_set_level(EXAMPLE_PIN_NUM_LCD_RST, 0);
    vTaskDelay(pdMS_TO_TICKS(100));
    gpio_set_level(EXAMPLE_PIN_NUM_LCD_RST, 1);
    vTaskDelay(pdMS_TO_TICKS(100));
}

static void lcd_write_cmd(uint8_t cmd)
{
    gpio_set_level(EXAMPLE_PIN_NUM_LCD_DC, 0);
    spi_transaction_t t = {0};
    t.length = 8;
    t.tx_buffer = &cmd;
    spi_device_polling_transmit(lcd_spi_handle, &t);
}

static void lcd_write_data(const uint8_t *data, int len)
{
    gpio_set_level(EXAMPLE_PIN_NUM_LCD_DC, 1);
    spi_transaction_t t = {0};
    t.length = len * 8;
    t.tx_buffer = data;
    spi_device_polling_transmit(lcd_spi_handle, &t);
}

static void lcd_write_data16(uint16_t data)
{
    uint8_t data_buf[2] = {0, 0};
    data_buf[0] = data >> 8;
    data_buf[1] = data & 0xFF;
    lcd_write_data(data_buf, 2);
}

static void lcd_set_window(uint16_t xstar, uint16_t ystar, uint16_t xend, uint16_t yend)
{
    uint8_t databuf[4] = {0, 0, 0, 0};
    databuf[0] = xstar >> 8;
    databuf[1] = xstar & 0xFF;
    databuf[2] = xend >> 8;
    databuf[3] = xend & 0xFF;
    lcd_write_cmd(0x2A);
    lcd_write_data(databuf, 4);

    databuf[0] = ystar >> 8;
    databuf[1] = ystar & 0xFF;
    databuf[2] = yend >> 8;
    databuf[3] = yend & 0xFF;
    lcd_write_cmd(0x2B);
    lcd_write_data(databuf, 4);

    lcd_write_cmd(0x2C);
}

static void lcd_fill(uint16_t sx, uint16_t sy, uint16_t ex, uint16_t ey, uint16_t color)
{
    uint16_t width = ex - sx + 1;
    uint16_t height = ey - sy + 1;
    lcd_set_window(sx, sy, ex, ey);

    uint8_t data_buf[2] = {0};
    data_buf[0] = color >> 8;
    data_buf[1] = color & 0xFF;

    for (uint16_t i = 0; i < height; i++) {
        for (uint16_t j = 0; j < width; j++) {
            lcd_write_data(data_buf, 2);
        }
    }
}

static void lcd_clear(uint16_t color)
{
    lcd_fill(0, 0, LCD_WIDTH - 1, LCD_HEIGHT - 1, color);
}

const unsigned char asc2_1608[95][16] = {
    {0x00,0x00,0x00,0x00,0x00,0x00,0x00,0x00,0x00,0x00,0x00,0x00,0x00,0x00,0x00,0x00},
    {0x00,0x00,0x00,0x10,0x10,0x10,0x10,0x10,0x10,0x10,0x00,0x00,0x10,0x10,0x00,0x00},
    {0x00,0x12,0x24,0x24,0x48,0x00,0x00,0x00,0x00,0x00,0x00,0x00,0x00,0x00,0x00,0x00},
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    {0x20,0x5A,0x04,0x00,0x00,0x00,0x00,0x00,0x00,0x00,0x00,0x00,0x00,0x00,0x00,0x00},
};

static void lcd_show_char(uint16_t x, uint16_t y, uint8_t chr, uint8_t size, uint16_t color)
{
    uint8_t temp = 0, t1 = 0;
    uint8_t *pfont = 0;
    uint8_t csize = 0;
    uint16_t colortemp = 0;

    csize = (size / 8 + ((size % 8) ? 1 : 0)) * (size / 2);
    chr = chr - ' ';

    if ((x > (LCD_WIDTH - size / 2)) || (y > (LCD_HEIGHT - size))) {
        return;
    }

    lcd_set_window(x, y, x + size / 2 - 1, y + size - 1);

    switch (size) {
        case 16:
            pfont = (uint8_t *)asc2_1608[chr];
            break;
        default:
            return;
    }

    csize = (size / 8 + ((size % 8) ? 1 : 0)) * (size / 2);

    for (uint8_t t = 0; t < csize; t++) {
        temp = pfont[t];
        for (t1 = 0; t1 < 8; t1++) {
            if (temp & 0x80) {
                colortemp = color;
            } else {
                colortemp = BLACK;
            }
            lcd_write_data16(colortemp);
            temp <<= 1;
        }
    }
}

static void lcd_show_string(uint16_t x, uint16_t y, uint8_t size, char *p, uint16_t color)
{
    uint8_t x0 = x;
    while ((*p <= '~') && (*p >= ' ')) {
        if (x >= LCD_WIDTH) {
            x = x0;
            y += size;
        }
        if (y >= LCD_HEIGHT) break;
        lcd_show_char(x, y, *p, size, color);
        x += size / 2;
        p++;
    }
}

static int lcd_find_chinese_char(uint32_t code)
{
    int low = 0, high = LONGYIN_CHAR_COUNT - 1;
    while (low <= high) {
        int mid = (low + high) / 2;
        if (longyin_char_codes[mid] == code) {
            return mid;
        } else if (longyin_char_codes[mid] < code) {
            low = mid + 1;
        } else {
            high = mid - 1;
        }
    }
    return -1;
}

static void lcd_show_chinese_char(uint16_t x, uint16_t y, uint32_t code, uint16_t color)
{
    int index = lcd_find_chinese_char(code);
    if (index < 0) return;

    lcd_set_window(x, y, x + 15, y + 15);

    const uint8_t *pfont = longyin_font_data[index];
    uint8_t temp = 0, t1 = 0;
    uint16_t colortemp = 0;

    for (uint8_t t = 0; t < 32; t += 2) {
        temp = pfont[t] << 8 | pfont[t + 1];
        for (t1 = 0; t1 < 16; t1++) {
            if (temp & 0x8000) {
                colortemp = color;
            } else {
                colortemp = BLACK;
            }
            lcd_write_data16(colortemp);
            temp <<= 1;
        }
    }
}

static void lcd_show_chinese_string(uint16_t x, uint16_t y, uint16_t *str, uint16_t color)
{
    uint16_t x0 = x;
    while (*str != 0) {
        if (x >= LCD_WIDTH - 15) {
            x = x0;
            y += 16;
        }
        if (y >= LCD_HEIGHT) break;
        lcd_show_chinese_char(x, y, *str, color);
        x += 16;
        str++;
    }
}

static void lcd_init(void)
{
    gpio_config_t gpio_init_struct;

    spi_device_interface_config_t devcfg = {
        .clock_speed_hz = 60 * 1000 * 1000,
        .mode = 0,
        .spics_io_num = EXAMPLE_PIN_NUM_LCD_CS,
        .queue_size = 7,
    };

    ESP_ERROR_CHECK(spi_bus_add_device(LCD_HOST, &devcfg, &lcd_spi_handle));

    gpio_init_struct.intr_type = GPIO_INTR_DISABLE;
    gpio_init_struct.mode = GPIO_MODE_OUTPUT;
    gpio_init_struct.pin_bit_mask = 1ULL << EXAMPLE_PIN_NUM_LCD_DC;
    gpio_init_struct.pull_down_en = GPIO_PULLDOWN_DISABLE;
    gpio_init_struct.pull_up_en = GPIO_PULLUP_ENABLE;
    gpio_config(&gpio_init_struct);

    gpio_init_struct.pin_bit_mask = 1ULL << EXAMPLE_PIN_NUM_LCD_RST;
    gpio_config(&gpio_init_struct);

    xl9555_pin_write(SLCD_PWR_IO, 1);
    vTaskDelay(pdMS_TO_TICKS(10));

    lcd_hard_reset();

    uint8_t cmd_data[1];

    lcd_write_cmd(0x11);
    vTaskDelay(pdMS_TO_TICKS(120));

    cmd_data[0] = 0xA0;
    lcd_write_cmd(0x36);
    lcd_write_data(cmd_data, 1);

    cmd_data[0] = 0x65;
    lcd_write_cmd(0x3A);
    lcd_write_data(cmd_data, 1);

    lcd_write_cmd(0x21);
    vTaskDelay(pdMS_TO_TICKS(120));

    lcd_write_cmd(0x29);
    vTaskDelay(pdMS_TO_TICKS(120));
}

static void tft_test_task(void *arg)
{
    ESP_LOGI(TAG, "TFT测试任务开始");

    ESP_LOGI(TAG, "初始化I2C总线...");
    i2c_init();

    ESP_LOGI(TAG, "初始化XL9555 IO扩展芯片...");
    uint8_t data[2] = {0x00, 0x00};
    xl9555_write_byte(XL9555_CONFIG_PORT0_REG, data, 2);
    xl9555_write_byte(XL9555_OUTPUT_PORT0_REG, data, 2);
    vTaskDelay(pdMS_TO_TICKS(10));

    ESP_LOGI(TAG, "打开背光...");
    xl9555_pin_write(LCD_BL_IO, 1);

    ESP_LOGI(TAG, "初始化SPI总线...");
    spi_bus_config_t buscfg = {
        .mosi_io_num = EXAMPLE_PIN_NUM_MOSI,
        .miso_io_num = EXAMPLE_PIN_NUM_MISO,
        .sclk_io_num = EXAMPLE_PIN_NUM_SCLK,
        .quadwp_io_num = -1,
        .quadhd_io_num = -1,
        .max_transfer_sz = LCD_WIDTH * LCD_HEIGHT * 2,
    };
    ESP_ERROR_CHECK(spi_bus_initialize(LCD_HOST, &buscfg, SPI_DMA_CH_AUTO));

    ESP_LOGI(TAG, "初始化ILI9341面板...");
    lcd_init();

    ESP_LOGI(TAG, "测试纯色填充(白色)...");
    lcd_clear(WHITE);
    vTaskDelay(pdMS_TO_TICKS(1000));

    ESP_LOGI(TAG, "测试纯色填充(红色)...");
    lcd_clear(RED);
    vTaskDelay(pdMS_TO_TICKS(1000));

    ESP_LOGI(TAG, "测试纯色填充(绿色)...");
    lcd_clear(GREEN);
    vTaskDelay(pdMS_TO_TICKS(1000));

    ESP_LOGI(TAG, "测试纯色填充(蓝色)...");
    lcd_clear(BLUE);
    vTaskDelay(pdMS_TO_TICKS(1000));

    ESP_LOGI(TAG, "测试显示文字...");
    lcd_clear(WHITE);

    lcd_show_string(50, 50, 16, "Hello World!", RED);
    lcd_show_string(50, 80, 16, "2.4\" TFT LCD Test", BLUE);
    lcd_show_string(50, 110, 16, "Version: ", GREEN);
    lcd_show_string(130, 110, 16, "1.0.0", BLACK);

    uint16_t chinese_text[] = {0x4F60, 0x597D, 0x4E16, 0x754C, 0, 0, 0, 0};
    lcd_show_chinese_string(50, 160, chinese_text, RED);

    uint16_t chinese_text2[] = {0x4E2D, 0x6587, 0x663E, 0x793A, 0x6D4B, 0x8BD5, 0, 0};
    lcd_show_chinese_string(50, 180, chinese_text2, BLUE);

    uint16_t chinese_text3[] = {0x5B57, 0x9B42, 0x9F99, 0x9F99, 0x624B, 0x4E66, 0, 0};
    lcd_show_chinese_string(50, 200, chinese_text3, GREEN);

    ESP_LOGI(TAG, "测试完成");

    while (1) {
        vTaskDelay(pdMS_TO_TICKS(1000));
    }
}

static esp_err_t firmware_backup_to_ext_flash(void) {
    const esp_partition_t *running_part = esp_ota_get_running_partition();
    if (!running_part) {
        ESP_LOGE(TAG, "无法获取当前运行分区");
        return ESP_FAIL;
    }

    ESP_LOGI(TAG, "当前运行分区: %s (offset: 0x%06X, size: 0x%06X)",
             running_part->label, running_part->address, running_part->size);
    ESP_LOGI(TAG, "当前固件版本: v%d.%d.%d", VERSION_MAJOR, VERSION_MINOR, VERSION_PATCH);

    ESP_LOGI(TAG, "正在擦除外部 Flash 备份区域...");
    for (uint32_t addr = FIRMWARE_BACKUP_ADDR; addr < FIRMWARE_BACKUP_ADDR + FIRMWARE_SIZE; addr += W25Q128_SECTOR_SIZE) {
        esp_err_t ret = W25Q_EraseSector(addr);
        if (ret != ESP_OK) {
            ESP_LOGE(TAG, "擦除扇区 0x%06X 失败: %s", addr, esp_err_to_name(ret));
            return ret;
        }
    }
    ESP_LOGI(TAG, "擦除完成");

    ESP_LOGI(TAG, "正在备份固件到外部 Flash...");
    uint8_t *buf = malloc(W25Q128_SECTOR_SIZE);
    if (!buf) {
        ESP_LOGE(TAG, "内存分配失败");
        return ESP_FAIL;
    }

    for (uint32_t offset = 0; offset < running_part->size; offset += W25Q128_SECTOR_SIZE) {
        uint32_t read_size = (running_part->size - offset) > W25Q128_SECTOR_SIZE ? W25Q128_SECTOR_SIZE : (running_part->size - offset);

        esp_err_t ret = esp_partition_read(running_part, offset, buf, read_size);
        if (ret != ESP_OK) {
            ESP_LOGE(TAG, "读取内部 Flash 失败: %s", esp_err_to_name(ret));
            free(buf);
            return ret;
        }

        ret = W25Q_Write(FIRMWARE_BACKUP_ADDR + offset, buf, read_size);
        if (ret != ESP_OK) {
            ESP_LOGE(TAG, "写入外部 Flash 失败: %s", esp_err_to_name(ret));
            free(buf);
            return ret;
        }

        if ((offset / W25Q128_SECTOR_SIZE) % 16 == 0) {
            ESP_LOGI(TAG, "备份进度: %d/%d sectors", offset / W25Q128_SECTOR_SIZE, running_part->size / W25Q128_SECTOR_SIZE);
        }
    }
    free(buf);

    ESP_LOGI(TAG, "固件备份完成！");
    return ESP_OK;
}

static __attribute__((unused)) esp_err_t firmware_restore_from_ext_flash(void) {
    const esp_partition_t *ota_part = esp_partition_find_first(ESP_PARTITION_TYPE_APP, ESP_PARTITION_SUBTYPE_APP_OTA_1, NULL);
    if (!ota_part) {
        ESP_LOGE(TAG, "无法找到 OTA 分区");
        return ESP_FAIL;
    }

    ESP_LOGI(TAG, "目标恢复分区: %s (offset: 0x%06X, size: 0x%06X)",
             ota_part->label, ota_part->address, ota_part->size);
    ESP_LOGI(TAG, "待恢复固件版本: v%d.%d.%d", VERSION_MAJOR, VERSION_MINOR, VERSION_PATCH);

    ESP_LOGI(TAG, "正在擦除目标 OTA 分区...");
    esp_err_t ret = esp_partition_erase_range(ota_part, 0, ota_part->size);
    if (ret != ESP_OK) {
        ESP_LOGE(TAG, "擦除 OTA 分区失败: %s", esp_err_to_name(ret));
        return ret;
    }
    ESP_LOGI(TAG, "擦除完成");

    ESP_LOGI(TAG, "正在从外部 Flash 恢复固件...");
    uint8_t *buf = malloc(W25Q128_SECTOR_SIZE);
    if (!buf) {
        ESP_LOGE(TAG, "内存分配失败");
        return ESP_FAIL;
    }

    for (uint32_t offset = 0; offset < FIRMWARE_SIZE; offset += W25Q128_SECTOR_SIZE) {
        uint32_t read_size = (FIRMWARE_SIZE - offset) > W25Q128_SECTOR_SIZE ? W25Q128_SECTOR_SIZE : (FIRMWARE_SIZE - offset);

        esp_err_t ret = W25Q_Read(FIRMWARE_BACKUP_ADDR + offset, buf, read_size);
        if (ret != ESP_OK) {
            ESP_LOGE(TAG, "读取外部 Flash 失败: %s", esp_err_to_name(ret));
            free(buf);
            return ret;
        }

        ret = esp_partition_write(ota_part, offset, buf, read_size);
        if (ret != ESP_OK) {
            ESP_LOGE(TAG, "写入 OTA 分区失败: %s", esp_err_to_name(ret));
            free(buf);
            return ret;
        }

        if ((offset / W25Q128_SECTOR_SIZE) % 16 == 0) {
            ESP_LOGI(TAG, "恢复进度: %d/%d sectors", offset / W25Q128_SECTOR_SIZE, FIRMWARE_SIZE / W25Q128_SECTOR_SIZE);
        }
    }
    free(buf);

    ESP_LOGI(TAG, "固件恢复完成！");
    ESP_LOGI(TAG, "正在设置 OTA_1 为启动分区...");

    ret = esp_ota_set_boot_partition(ota_part);
    if (ret != ESP_OK) {
        ESP_LOGE(TAG, "设置启动分区失败: %s", esp_err_to_name(ret));
        return ret;
    }

    ESP_LOGI(TAG, "设置成功！即将重启...");
    esp_restart();

    return ESP_OK;
}

void app_main(void)
{
  ESP_LOGI(TAG, "应用程序启动");

  if (W25Q_Init() != ESP_OK) {
    ESP_LOGE(TAG, "W25Q128 Flash 初始化失败");
  } else {
    ESP_LOGI(TAG, "W25Q128 Flash 初始化成功");

    uint32_t test_addr = 0x000000;
    const char *test_data = "Hello W25Q128!";
    char read_buf[64] = {0};

    ESP_LOGI(TAG, "正在擦除扇区 0x%06X...", test_addr);
    esp_err_t ret = W25Q_EraseSector(test_addr);
    if (ret != ESP_OK) {
      ESP_LOGE(TAG, "擦除失败: %s", esp_err_to_name(ret));
    } else {
      ESP_LOGI(TAG, "擦除成功");

      ESP_LOGI(TAG, "正在写入数据: %s", test_data);
      ret = W25Q_Write(test_addr, (const uint8_t *)test_data, strlen(test_data) + 1);
      if (ret != ESP_OK) {
        ESP_LOGE(TAG, "写入失败: %s", esp_err_to_name(ret));
      } else {
        ESP_LOGI(TAG, "写入成功");

        ESP_LOGI(TAG, "正在读取数据...");
        ret = W25Q_Read(test_addr, (uint8_t *)read_buf, strlen(test_data) + 1);
        if (ret != ESP_OK) {
          ESP_LOGE(TAG, "读取失败: %s", esp_err_to_name(ret));
        } else {
          ESP_LOGI(TAG, "读取成功: %s", read_buf);
          if (strcmp(test_data, read_buf) == 0) {
            ESP_LOGI(TAG, "数据验证通过！");
          } else {
            ESP_LOGE(TAG, "数据验证失败！");
          }
        }
      }

      ESP_LOGI(TAG, "正在备份当前固件到外部 Flash...");
      esp_err_t backup_ret = firmware_backup_to_ext_flash();
      if (backup_ret != ESP_OK) {
        ESP_LOGE(TAG, "固件备份失败");
      } else {
        ESP_LOGI(TAG, "固件备份成功！");
      }
    }
  }

  ESP_LOGI(TAG, "版本号: %d.%d.%d", VERSION_MAJOR, VERSION_MINOR,
           VERSION_PATCH);

  xTaskCreate(tft_test_task, "tft_test_task", 8192, NULL, 5, NULL);

  ESP_LOGI(TAG, "TFT测试任务已创建");
}