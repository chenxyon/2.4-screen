## sdkconfig.defaults
```kconfig
# TFT ILI9341 Configuration
CONFIG_TFT_ILI9341_ENABLED=y
CONFIG_TFT_ILI9341_SPI_HOST=2
CONFIG_TFT_ILI9341_MOSI_PIN=13
CONFIG_TFT_ILI9341_MISO_PIN=15
CONFIG_TFT_ILI9341_SCLK_PIN=10
CONFIG_TFT_ILI9341_CS_PIN=12
CONFIG_TFT_ILI9341_DC_PIN=11
CONFIG_TFT_ILI9341_RST_PIN=14
CONFIG_TFT_ILI9341_BL_PIN=38
CONFIG_TFT_ILI9341_SPI_FREQ=40
CONFIG_TFT_ILI9341_DMA_CHANNEL=1
```
